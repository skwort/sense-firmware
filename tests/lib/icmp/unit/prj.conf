## CMakeLists.txt
```
cmake_minimum_required(VERSION 3.20.0)
find_package(Zephyr REQUIRED HINTS $ENV{ZEPHYR_BASE})
project(test_icmp)

FILE(GLOB app_sources src/*.c)
target_sources(app PRIVATE ${app_sources})

target_include_directories(app PRIVATE ${CMAKE_CURRENT_SOURCE_DIR}/../../../../lib/icmp)
```

## prj.conf
```kconfig
CONFIG_ZTEST=y
CONFIG_COVERAGE=y
CONFIG_ICMP=y
CONFIG_ICMP_TESTING=y
CONFIG_HEAP_MEM_POOL_SIZE=1024
```

## src/icmp.c
```c
#include <zephyr/kernel.h>
#include <zephyr/ztest.h>
#include <lib/icmp.h>

#include "icmp_queue.h"
#include "icmp_frame.h"

/* Forward declaration of testing function for resetting inflight state */
void icmp_test_reset_inflight_state(void);

ZTEST(icmp, test_icmp_command_ok)
{
    /* Send the command */
    uint8_t payload[] = { 'H', 'e', 'l', 'l', 'o'};
    int ret = icmp_command(0x01, payload, 5, NULL, NULL);
    zassert_true(ret == 0, "Failed to issue ICMP COMMAND: %d", ret);

    struct icmp_frame *frame = NULL;
    ret = icmp_tx_dequeue(&frame, K_NO_WAIT);
    zassert_true(ret == 0,
                 "Failed to extract item from icmp tx_queue: %d", ret);

	zassert_equal(frame->type, ICMP_TYPE_COMMAND);
	zassert_equal(frame->target, 0x01);
	zassert_equal(frame->length, 5);
    zassert_mem_equal(frame->payload, payload, 5);

    icmp_frame_free(frame);
    icmp_test_reset_inflight_state();
}

#if CONFIG_ICMP_MAX_INFLIGHT_MSGS_8
#define ICMP_MAX_INFLIGHT_MSGS 8
#elif CONFIG_ICMP_MAX_INFLIGHT_MSGS_16
#define ICMP_MAX_INFLIGHT_MSGS 16
#elif CONFIG_ICMP_MAX_INFLIGHT_MSGS_32
#define ICMP_MAX_INFLIGHT_MSGS 32
#else
#error "Maximum number of ICMP inflight messages is undefined."
#endif

ZTEST(icmp, test_icmp_command_msg_id_overflow)
{
    /* Send the maximum number of commands */
    uint8_t payload[] = { 'H', 'e', 'l', 'l', 'o'};

    /* Send the maximum number of commands */
    int ret = 0;
    for (int i = 0; i < ICMP_MAX_INFLIGHT_MSGS; i++) {
        ret = icmp_command(0x01, payload, 5, NULL, NULL);
        zassert_true(ret == 0, "Failed to issue ICMP COMMAND: %d", ret);
    }

    /* Try sending an extra command */
    ret = icmp_command(0x01, payload, 5, NULL, NULL);
    zassert_true(ret == -EAGAIN, "ICMP inflight messages didn't overflow");

    /* Clean up */
    struct icmp_frame *frame = NULL;
    for (int i = 0; i < ICMP_MAX_INFLIGHT_MSGS; i++) {
        ret = icmp_tx_dequeue(&frame, K_NO_WAIT);
        zassert_true(ret == 0,
                    "Failed to extract item from icmp tx_queue: %d", ret);

        zassert_equal(frame->type, ICMP_TYPE_COMMAND);
        zassert_equal(frame->target, 0x01);
        zassert_equal(frame->length, 5);
        zassert_mem_equal(frame->payload, payload, 5);

        icmp_frame_free(frame);
        frame = NULL;
    }
    icmp_test_reset_inflight_state();
}

ZTEST(icmp, test_icmp_response_ok)
{
    /* Send the command */
    uint8_t payload[] = { 'H', 'e', 'l', 'l', 'o'};
    int ret = icmp_respond(0x01, 0x02, payload, 5);
    zassert_true(ret == 0, "Failed to issue ICMP RESPONSE: %d", ret);

    /* Send the command */
    struct icmp_frame *frame = NULL;
    ret = icmp_tx_dequeue(&frame, K_NO_WAIT);
    zassert_true(ret == 0,
                 "Failed to extract item from icmp tx_queue: %d", ret);

	zassert_equal(frame->type, ICMP_TYPE_RESPONSE);
	zassert_equal(frame->msg_id, 0x02);
	zassert_equal(frame->target, 0x01);
	zassert_equal(frame->length, 5);
    zassert_mem_equal(frame->payload, payload, 5);

    icmp_frame_free(frame);
}

ZTEST(icmp, test_icmp_notify_ok)
{
    /* Send the command */
    uint8_t payload[] = { 'H', 'e', 'l', 'l', 'o'};
    int ret = icmp_notify(0x01, payload, 5);
    zassert_true(ret == 0, "Failed to issue ICMP RESPONSE: %d", ret);

    /* Send the command */
    struct icmp_frame *frame = NULL;
    ret = icmp_tx_dequeue(&frame, K_NO_WAIT);
    zassert_true(ret == 0,
                 "Failed to extract item from icmp tx_queue: %d", ret);

	zassert_equal(frame->type, ICMP_TYPE_NOTIFY);
	zassert_equal(frame->target, 0x01);
	zassert_equal(frame->length, 5);
    zassert_mem_equal(frame->payload, payload, 5);

    icmp_frame_free(frame);
}

ZTEST(icmp, test_icmp_command_invalid_payload)
{
    uint8_t payload[ICMP_MAX_PAYLOAD_SIZE + 1] = {'x'};
    int ret = icmp_command(0x01, payload, sizeof(payload), NULL, NULL);
    zassert_true(ret == -EINVAL, "Unexpected return: %d", ret);
}

ZTEST(icmp, test_icmp_respond_invalid_payload)
{
    uint8_t payload[ICMP_MAX_PAYLOAD_SIZE + 1] = {'x'};
    int ret = icmp_respond(0x01, 0x02, payload, sizeof(payload));
    zassert_true(ret == -EINVAL, "Unexpected return: %d", ret);
}

ZTEST(icmp, test_icmp_notify_invalid_payload)
{
    uint8_t payload[ICMP_MAX_PAYLOAD_SIZE + 1] = {'x'};
    int ret = icmp_notify(0x01, payload, 65);
    zassert_true(ret == -EINVAL, "Unexpected return: %d", ret);
}

ZTEST(icmp, test_icmp_send_frame_fail)
{
    uint8_t payload[] = { 'H', 'e', 'l', 'l', 'o'};
    int ret;

    /* Exhaust all the slabs */
    for (int i = 0; i < CONFIG_ICMP_MAX_MEM_SLAB_FRAMES; i++) {
        ret = icmp_notify(0x01, payload, 5);
        zassert_true(ret == 0, "Unexpected return: %d", ret);
    }

    /* Try to allocate one more */
    ret = icmp_notify(0x01, payload, 5);
    zassert_true(ret == -ENOMEM, "Unexpected return: %d", ret);

    /* Clean-up */
    for (int i = 0; i < CONFIG_ICMP_MAX_MEM_SLAB_FRAMES; i++) {
        struct icmp_frame *frame = NULL;
        ret = icmp_tx_dequeue(&frame, K_NO_WAIT);
        zassert_true(ret == 0,
                    "Failed to extract item from icmp tx_queue: %d", ret);
        icmp_frame_free(frame);
    }
}

void rx_callback(const uint8_t *payload, size_t payload_len)
{
    ARG_UNUSED(payload);
    ARG_UNUSED(payload_len);
}

ZTEST(icmp, test_icmp_register_target_ok)
{
    int ret = icmp_register_target(0x01, (icmp_callback_t)rx_callback);
    zassert_true(ret == 0, "Unexpected return: %d", ret);
}

ZTEST(icmp, test_icmp_register_target_fail_target)
{
    int ret = icmp_register_target(CONFIG_ICMP_MAX_TARGETS,
                                   (icmp_callback_t)rx_callback);
    zassert_true(ret == -EINVAL, "Unexpected return: %d", ret);
}

ZTEST(icmp, test_icmp_register_target_fail_cb)
{
    int ret = icmp_register_target(0x01, NULL);
    zassert_true(ret == -EINVAL, "Unexpected return: %d", ret);
}

ZTEST_SUITE(icmp, NULL, NULL, NULL, NULL, NULL);
```

## src/icmp_queue.c
```c
#include <zephyr/kernel.h>
#include <zephyr/ztest.h>
#include <lib/icmp.h>
#include "icmp_queue.h"

/* Fixture for generating a valid frame */
static void valid_frame(struct icmp_frame * frame)
{
	frame->type = ICMP_TYPE_COMMAND,
	frame->msg_id = 0x01;
	frame->target = 0x01;
	frame->length = 5;
    frame->payload[0] = 'H';
    frame->payload[1] = 'e';
    frame->payload[2] = 'l';
    frame->payload[3] = 'l';
    frame->payload[4] = 'o';
}

ZTEST(icmp_queue, test_tx_queue_basic)
{
    struct icmp_frame *in_frame = k_malloc(sizeof(struct icmp_frame));
    struct icmp_frame *out_frame = NULL;

    valid_frame(in_frame);

    int ret = icmp_tx_enqueue(&in_frame, K_NO_WAIT);
    zassert_true(ret == 0, "TX enqueue failed.");

    ret = icmp_tx_dequeue(&out_frame, K_NO_WAIT);
    zassert_true(ret == 0, "TX dequeue failed.");

    zassert_equal_ptr(in_frame, out_frame, "In ptr is different to out ptr.");

    k_free(in_frame);
}

ZTEST(icmp_queue, test_rx_queue_basic)
{
    struct icmp_frame *in_frame = k_malloc(sizeof(struct icmp_frame));
    struct icmp_frame *out_frame = NULL;

    valid_frame(in_frame);

    int ret = icmp_rx_enqueue(&in_frame, K_NO_WAIT);
    zassert_true(ret == 0, "TX enqueue failed.");

    ret = icmp_rx_dequeue(&out_frame, K_NO_WAIT);
    zassert_true(ret == 0, "TX dequeue failed.");

    zassert_equal_ptr(in_frame, out_frame, "In ptr is different to out ptr.");

    k_free(in_frame);
}

ZTEST_SUITE(icmp_queue, NULL, NULL, NULL, NULL, NULL);
```
