## CMakeLists.txt
```
cmake_minimum_required(VERSION 3.13.1)

find_package(Zephyr REQUIRED HINTS $ENV{ZEPHYR_BASE})

project(cores-interface LANGUAGES C)

FILE(GLOB app_sources src/*.c)

target_sources(app PRIVATE ${app_sources})

add_subdirectory(src/sdi12)
```

## Kconfig
```
# Copyright (c) 2021 Nordic Semiconductor ASA
# SPDX-License-Identifier: Apache-2.0
#
# This file is the application Kconfig entry point. All application Kconfig
# options can be defined here or included via other application Kconfig files.
# You can browse these options using the west targets menuconfig (terminal) or
# guiconfig (GUI).

menu "Zephyr"
source "Kconfig.zephyr"
endmenu

rsource "../../lib/Kconfig"
```

## sample.yaml
```
# This file is provided so that the application can be compiled using Twister,
# the Zephyr testing tool. In this file, multiple combinations can be specified,
# so that you can easily test all of them locally or in CI.
sample:
  description: SENSE Interface Core
  name: cores-interface
common:
  sysbuild: true
  build_only: true
  integration_platforms:
    - sense_core/nrf5340/cpuapp/ns
tests:
  app.default: {}
  app.debug:
    extra_overlay_confs:
      - debug.conf
      - rtt.conf
```

## prj.conf
```kconfig
CONFIG_HEARTBEAT=y

# ICMP Config
CONFIG_ICMP=y
CONFIG_ICMP_PHY_UART=y
CONFIG_ICMP_LOG_LEVEL_ERR=y
CONFIG_UART_3_INTERRUPT_DRIVEN=n  # icmp_uart is mapped to UART3 and requires
CONFIG_UART_3_ASYNC=y             # the UART_ASYNC_API

# SDI-12 UART Configuration
CONFIG_UART_2_INTERRUPT_DRIVEN=n
CONFIG_UART_2_ASYNC=y

# Shell and Logging
CONFIG_LOG=y
CONFIG_SERIAL=y
CONFIG_SHELL=y
CONFIG_SHELL_WILDCARD=n   # Disable wildcards to allow '?' in SDI-12 commands
CONFIG_SHELL_PROMPT_UART="sense:~$ "

# USB Options
CONFIG_USB_DEVICE_STACK=y
CONFIG_USB_DEVICE_PRODUCT="SENSE IoT"
CONFIG_USB_DEVICE_PID=0x0004
CONFIG_SHELL_BACKEND_SERIAL_API_INTERRUPT_DRIVEN=y  # Required for USB Shell
CONFIG_USB_DEVICE_INITIALIZE_AT_BOOT=n
```

## debug.conf
```kconfig
# This Kconfig fragment enables debug-related options

# Compiler
CONFIG_DEBUG_OPTIMIZATIONS=y

# Logging
CONFIG_LOG=y

CONFIG_ASSERT=y
```

## rtt.conf
```kconfig
# # RTT
CONFIG_USE_SEGGER_RTT=y
CONFIG_CONSOLE=y
CONFIG_RTT_CONSOLE=y
CONFIG_UART_CONSOLE=n
CONFIG_LOG_BACKEND_RTT=y
```

## boards/nrf5340dk_nrf5340_cpuapp.overlay
```dts
/ {
	aliases {
		heartbeat-gpio = &led0;
	};
};
```

## src/main.c
```c
#include <zephyr/kernel.h>
#include <zephyr/logging/log.h>
#include <zephyr/usb/usb_device.h>

#include <app_version.h>
#include <lib/icmp.h>
#include <lib/heartbeat.h>

LOG_MODULE_REGISTER(main, LOG_LEVEL_ERR);

#ifdef CONFIG_ICMP
void icmp_test_cb(const uint8_t *payload, size_t payload_len)
{
    LOG_INF("ICMP payload received: %s", payload);
}
#endif /* CONFIG_ICMP */

int main(void)
{
    printk("SENSE Interface Core version %s\n", APP_VERSION_STRING);

#ifdef CONFIG_ICMP
    icmp_register_target(0, icmp_test_cb);
    icmp_init();

    uint8_t payload[] = {'n', 'r', 'f', '5', '3', '\0'};
#endif /* CONFIG_ICMP */

#ifdef CONFIG_HEARTBEAT
    if (heartbeat_init_start(K_MSEC(CONFIG_HEARTBEAT_DEFAULT_DURATION)))
        LOG_ERR("Failed to initialise heartbeat.");
#endif

#if DT_NODE_HAS_COMPAT(DT_CHOSEN(zephyr_shell_uart), zephyr_cdc_acm_uart)
	const struct device *usb;
	usb = DEVICE_DT_GET(DT_CHOSEN(zephyr_shell_uart));
	if (!device_is_ready(usb) || usb_enable(NULL)) {
		return 0;
	}
#endif

    while (1) {

#ifdef CONFIG_ICMP
        icmp_notify(0, payload, 6);
#endif /* CONFIG_ICMP */

        k_sleep(K_MSEC(1000));
    }

    return 0;
}
```
