## boards/skwort/sense_core/Kconfig.sense_core
```kconfig
config BOARD_SENSE_CORE
	select SOC_NRF9161_LACA        if BOARD_SENSE_CORE_NRF9161
	select SOC_NRF9161_LACA        if BOARD_SENSE_CORE_NRF9161_NS
	select SOC_NRF5340_CPUAPP_QKAA if BOARD_SENSE_CORE_NRF5340_CPUAPP
	select SOC_NRF5340_CPUAPP_QKAA if BOARD_SENSE_CORE_NRF5340_CPUAPP_NS
	select SOC_NRF5340_CPUNET_QKAA if BOARD_SENSE_CORE_NRF5340_CPUNET
```

## boards/skwort/sense_core/board.yml
```yaml
board:
  name: sense_core
  full_name: SENSE IoT Core
  vendor: skwort
  socs:
  - name: nrf9161
    variants:
    - name: 'ns'
  - name: 'nrf5340'
    variants:
    - name: 'ns'
      cpucluster: 'cpuapp'
  revision:
    format: major.minor.patch
    default: "0.0.0"
    revisions:
    - name: "0.0.0"
```

## boards/skwort/sense_core/sense_core_nrf5340_cpuapp_defconfig
```kconfig
# SPDX-License-Identifier: Apache-2.0

# Enable MPU
CONFIG_ARM_MPU=y

# Enable hardware stack protection
CONFIG_HW_STACK_PROTECTION=y

# Enable TrustZone-M
CONFIG_ARM_TRUSTZONE_M=y

# Enable GPIO
CONFIG_GPIO=y

# Synthesise LFCLK from HFCLK
CONFIG_CLOCK_CONTROL_NRF_K32SRC_SYNTH=y
CONFIG_CLOCK_CONTROL_NRF_K32SRC_XTAL=n
```

## boards/skwort/sense_core/sense_core_nrf5340_cpuapp_ns_defconfig
```kconfig
# SPDX-License-Identifier: Apache-2.0

# Enable MPU
CONFIG_ARM_MPU=y

# Enable hardware stack protection
CONFIG_HW_STACK_PROTECTION=y

# Enable TrustZone-M
CONFIG_ARM_TRUSTZONE_M=y

# This Board implies building Non-Secure firmware
CONFIG_TRUSTED_EXECUTION_NONSECURE=y

# Enable GPIO
CONFIG_GPIO=y

# Synthesise LFCLK from HFCLK
CONFIG_CLOCK_CONTROL_NRF_K32SRC_SYNTH=y
CONFIG_CLOCK_CONTROL_NRF_K32SRC_XTAL=n

# Disable TF-M logging to free up peripheral line
CONFIG_TFM_LOG_LEVEL_SILENCE=y
```

## boards/skwort/sense_core/sense_core_nrf9161_ns_defconfig
```kconfig
# SPDX-License-Identifier: Apache-2.0

# Enable MPU
CONFIG_ARM_MPU=y

# Enable hardware stack protection
CONFIG_HW_STACK_PROTECTION=y

# Enable TrustZone-M
CONFIG_ARM_TRUSTZONE_M=y

# This board implies building Non-Secure firmware
CONFIG_TRUSTED_EXECUTION_NONSECURE=y

# Enable GPIO
CONFIG_GPIO=y

# Disable TF-M logging to free up peripheral line 0
CONFIG_TFM_LOG_LEVEL_SILENCE=y
```

## cores/control/src/sd_card/Kconfig
```kconfig
menuconfig SD_CARD_WRITER
	bool "SD Card Writer module"
	select DISK_ACCESS
	select DISK_DRIVER_SDMMC
	select FILE_SYSTEM
	select FAT_FILESYSTEM_ELM
	default y

module = SD_CARD_WRITER
module-str = SENSE Core SD card writer module
source "subsys/logging/Kconfig.template.log_config"
```

## cores/control/src/sensors/Kconfig
```kconfig
menu "SENSE Core Sensors"

config SENSE_CORE_SENSORS
    bool "Enable sensor support"
    default y

rsource "gnss/Kconfig"
rsource "imu/Kconfig"
rsource "temp_hum/Kconfig"

endmenu
```

## cores/control/src/sensors/adc/Kconfig
```kconfig
menuconfig SENSE_CORE_SENSOR_ADCS
	bool "SENSE Core external ADS1015 ADCs"
	select ADC
	default y


if SENSE_CORE_SENSOR_ADCS

config SENSE_CORE_SENSOR_ADCS_SEQ_SAMPLES
	int "Number of samples to collect in an ADC sampling sequence"
	range 1 5
	default 2

endif

module = SENSE_CORE_SENSOR_ADCS
module-str = SENSE Core external ADCs
source "subsys/logging/Kconfig.template.log_config"
```

## cores/control/src/sensors/gnss/Kconfig
```kconfig
menuconfig SENSE_CORE_SENSOR_GNSS
    bool "SENSE Core GNSS module"
    default y

if SENSE_CORE_SENSOR_GNSS

config SENSE_CORE_GNSS_DEFAULT_FIX_INTERVAL
	int "Fix interval for periodic fixes"
	range 10 65535
	default 120
	help
	  Fix interval (in seconds) for periodic fixes.

config SENSE_CORE_GNSS_DEFAULT_PERIODIC_TIMEOUT
	int "Fix timeout for periodic fixes"
	range 0 65535
	default 60
	help
	  Fix timeout (in seconds) for periodic fixes.
	  If set to zero, GNSS is allowed to run indefinitely until a valid PVT estimate is produced.

endif

module = SENSE_CORE_SENSOR_GNSS
module-str = SENSE Core GNSS module
source "subsys/logging/Kconfig.template.log_config"
```

## cores/control/src/sensors/imu/Kconfig
```kconfig
menuconfig SENSE_CORE_SENSOR_IMU
    bool "SENSE Core inertial movement sensors"
    default y

if SENSE_CORE_SENSOR_IMU

config SENSE_CORE_SENSOR_LSM6DSO
    bool "LSM6DSO accelerometer"
    default y

config SENSE_CORE_SENSOR_LIS3MDL
    bool "LIS3MDL magnetometer"
    default y

endif

module = SENSE_CORE_SENSOR_IMU
module-str = SENSE Core inertial movement sensors
source "subsys/logging/Kconfig.template.log_config"
```

## cores/control/src/sensors/temp_hum/Kconfig
```kconfig
menuconfig SENSE_CORE_SENSOR_TEMP_HUM
    bool "Temperature and humidity sensors"
    default y

if SENSE_CORE_SENSOR_TEMP_HUM

config SENSE_CORE_SENSOR_SHT4X
    bool "SHT4x temperature and humidity Sensor"
    default y

endif

module = SENSE_CORE_SENSOR_TEMP_HUM
module-str = SENSE Core temperature and humidity sensors
source "subsys/logging/Kconfig.template.log_config"
```

## dts/bindings/load-switch.yaml
```yaml
description: GPIO pin to enable or disable a load-switch

compatible: "load-switch"

properties:
  gpios:
    type: phandle-array
    required: true
    description: |
      The GPIO connected to the enable pin of the load switch.
```

## dts/bindings/sdi12-gpios.yaml
```yaml
description: GPIOs used for the custom SDI-12 circuit

compatible: "sdi12-gpios"

properties:
  not-space-gpio:
    type: phandle-array
    required: true
    specifier-space: gpio
    description: |
      The GPIO connected to the ~SPACE pin.
  tx-en-gpio:
    type: phandle-array
    required: true
    specifier-space: gpio
    description: |
      The GPIO connected to the TX_EN pin.
  rx-en-gpio:
    type: phandle-array
    required: true
    specifier-space: gpio
    description: |
      The GPIO connected to the RX_EN pin.
```

## lib/Kconfig
```kconfig
menu "Heartbeat Library"

rsource "heartbeat/Kconfig"

endmenu

menu "ICMP Library"

rsource "icmp/Kconfig"

endmenu

menu "Cellular Library"

rsource "cellular/Kconfig"

endmenu

menu "CoAP Helper Library"

rsource "coap/Kconfig"

endmenu
```

## lib/cellular/Kconfig
```kconfig
config CELLULAR
	bool "Enable the cellular interface"
	select NETWORKING
	select POSIX_API
	select NET_DRIVERS
	select NET_SOCKETS
	select NET_SOCKETS_OFFLOAD
	select NET_UDP
	default n

if CELLULAR

config REMOTE_SERVER_HOSTNAME
	string "Remote server hostname"

config REMOTE_SERVER_PORT
	int "Remote server port"

config CELLULAR_CONN_TIMEOUT
	int "The timeout period for the initial cellular connection in seconds"
	depends on CELLULAR
	default 120
	help
	  This value sets how long the celluar thread will wait for a valid
	  cellular connection. If a connection is not made within the timeout
	  period, then the thread will be terminated.

config CELLULAR_UPLINK_BUFFER_SIZE
	int "The size of uplink buffer used for transmission."
	depends on CELLULAR
	default 256
	help
	  This value sets an upper limit on the number able to be sent in a
	  single transmission. This value should be tuned to the maximum
	  cellular packet size to avoid packet fragmentation.

config CELLULAR_DOWNLINK_BUFFER_SIZE
	int "The size of downlink buffer used for reception."
	depends on CELLULAR
	default 256
	help
	  This value sets the maximum number of bytes returnable from the
	  remote server socket. This value should be tuned to the maximum
	  cellular packet size to avoid packet fragmentation.

config CELLULAR_THREAD_STACK_SIZE
	int "The size of the ICMP thread's stack."
	depends on CELLULAR
	default 1024

config CELLULAR_THREAD_PRIORITY
	int "The priority of the ICMP thread."
	depends on CELLULAR
	default 5

config CELLULAR_UPLINK_QUEUE_MAX_ITEMS
	int "Maximum number of packets allowed in the uplink queue"
	depends on CELLULAR
	default 8
	help
	  Calls to the cellular_packet_send function append the packets to
	  an uplink queue. This option sets the maximum number if items in
	  that queue. This number should be optimised to balance performance
	  and memory overhead.

choice CELLULAR_BACKEND
	prompt "Select the cellular backend"
	default CELLULAR_BACKEND_NONE

config CELLULAR_BACKEND_NRF
	bool "Use the nRF91 modem"
	select NRF_MODEM_LIB
	select LTE_LINK_CONTROL

config CELLULAR_BACKEND_NONE
	bool "Unspecified cellular backend"
	help
	  An unspecified cellular backend will cause build errors. This choice
	  is included to simplify testing.

endchoice # CELLULAR_BACKEND

module = CELLULAR
module-str = CELLULAR
source "subsys/logging/Kconfig.template.log_config"

endif # CELLULAR
```

## lib/coap/Kconfig
```kconfig
config COAP_LIB
	bool "Enable the CoAP Helper Library"
	default n
	select NETWORKING
	select COAP

if COAP_LIB

config COAP_MAX_MSG_LEN
	int "Maximum CoAP message length"
	default 256

module = COAP_LIB
module-str = COAP_LIB
source "subsys/logging/Kconfig.template.log_config"

endif # COAP_LIB
```

## lib/czd/Kconfig
```kconfig
config CZD
	bool "Enable the CBOR-ZCBOR-Defintion Library"
	default n
	select ZCBOR
	help
	  This option enables the 'CZD' library.

config CZD_DATAPOINT
	bool "Enable the DATAPOINT subset of CZD"
	depends on CZD
	default n
	select ZCBOR

config CZD_COMMAND
	bool "Enable the COMMAND subset of CZD"
	depends on CZD
	default n
	select ZCBOR

module = CZD
module-str = CZD
source "subsys/logging/Kconfig.template.log_config"
```

## lib/heartbeat/Kconfig
```kconfig
config HEARTBEAT
	bool "Enable the heartbeat"
	default y
	help
	  This option enables the 'heartbeat' library

config HEARTBEAT_DEFAULT_DURATION
	int "Default duration of the heartbeat timer"
	depends on HEARTBEAT
	default 1000
	help
	  This specifies the default duration in milliseconds of the heartbeat
	  timer used during system initialisation
```

## lib/icmp/Kconfig
```kconfig
config ICMP
	bool "Enable the Inter-Core Message Protocol"
	default n
	select CRC
	help
	  This option enables the 'ICMP' library.

config ICMP_MAX_PAYLOAD_SIZE
	int "Maximum payload size for ICMP messages"
	default 64
	depends on ICMP
	help
	  This value represents the maximum payload size for ICMP messages. It
	  should be tuned according to the maximum expected payload size to
	  reduce the memory footprint of the ICMP module.

config ICMP_MAX_MEM_SLAB_FRAMES
	int "Maximum number of ICMP frames allowed on the memory slab"
	depends on ICMP
	default 8
	help
	  Memory slab blocks are used to store the in-flight ICMP frames. This
	  Kconfig variable sets the upper limit on the number of in-flight
	  frames allowed within the ICMP server. The chosen value should be
	  tuned to balance performance and memory overhead.

config ICMP_MAX_TARGETS
	int "Maximum number of ICMP targets allowed in the dispatch table."
	depends on ICMP
	default 5

config ICMP_THREAD_STACK_SIZE
	int "The size of the ICMP thread's stack."
	depends on ICMP
	default 1024

config ICMP_THREAD_PRIORITY
	int "The priority of the ICMP thread."
	depends on ICMP
	default 5

choice ICMP_MAX_INFLIGHT_MSGS
	prompt "Select ICMP maximum inflight messages"
	depends on ICMP
	default ICMP_MAX_INFLIGHT_MSGS_8

config ICMP_MAX_INFLIGHT_MSGS_8
	bool "8"
	help
	  Select 8 maximum inflight messages for the ICMP server.

config ICMP_MAX_INFLIGHT_MSGS_16
	bool "16"
	help
	  Select 16 maximum inflight messages for the ICMP server.

config ICMP_MAX_INFLIGHT_MSGS_32
	bool "32"
	help
	  Select 32 maximum inflight messages for the ICMP server.

endchoice # ICMP_MAX_INFLIGHT_MSGS

config ICMP_MAX_INFLIGHT_MSG_AGE
	int "Set the maximum age of all inflight messages in milliseconds."
	depends on ICMP
	default 1000
	help
	  Set the maximum age of all inflight messages in milliseconds. If an
	  inflight message's age reaches this value before a response is
	  received, the message will be dropped. The msg_id for this message
	  will be invalidated and future message will be dropped. ICMP hosts
	  are expected to reply within this time period. If no response is
	  received, the command issuer should retry.

config ICMP_INFLIGHT_TIMEOUT_CHECK_PERIOD
	int "Set the frequency of timeout checking within ICMP."
	depends on ICMP
	default 300
	help
	  ICMP periodically checks for inflight message timeouts. This Kconfig
	  determines the period of this check. The value should not be too
	  small to avoid polluting the system workqueue and locking the
	  inflight mutex.

config ICMP_TESTING
	bool "Enable special unit testing functions."
	depends on ICMP
	default n
	help
	  This Kconfig includes additonal functions for testing purposes in the
	  build. This value must be disable for production builds.

config ICMP_PHY_UART
	bool "Enable the ICMP UART PHY"
	default n
	depends on ICMP
	select SERIAL
	select UART_ASYNC_API
	help
	  This option enables the ICMP UART PHY backend.

module = ICMP
module-str = ICMP
source "subsys/logging/Kconfig.template.log_config"
```

## tests/lib/cellular/integration/testcase.yaml
```yaml
tests:
  lib.cellular.integration:
    platform_allow: native_sim
    tags: cellular
    timeout: 5
```

## tests/lib/cellular/unit/testcase.yaml
```yaml
tests:
  lib.cellular.unit:
    platform_allow: native_sim
    tags: cellular
    timeout: 5
```

## tests/lib/coap/unit/testcase.yaml
```yaml
tests:
  lib.coap.unit:
    platform_allow: native_sim
    tags: coap
    timeout: 5
```

## tests/lib/icmp/integration/testcase.yaml
```yaml
tests:
  lib.icmp.integration:
    platform_allow: native_sim
    tags: icmp
    timeout: 5
```

## tests/lib/icmp/unit/testcase.yaml
```yaml
tests:
  lib.icmp.unit:
    platform_allow: native_sim
    tags: icmp
    timeout: 5
```
